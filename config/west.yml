## config/west.yml
```yaml
manifest:
  remotes:
    - name: zmk
      url-base: https://github.com/zmkfirmware
    - name: inorichi
      url-base: https://github.com/inorichi
  projects:
    - name: zmk
      remote: zmk
      revision: v0.3  # Pinned to last stable release (pre-Zephyr 4.1)
      import:
        - app/west.yml
    - name: zmk-pmw3610-driver
      remote: inorichi
      revision: main  # Original PMW3610 driver, compatible with ZMK v0.3 / Zephyr 3.5
  self:
    path: config
```
